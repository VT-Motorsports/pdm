## boards/st/vcu_stm32/Kconfig.defconfig
```kconfig
# Copyright (c) 2025 VCU Team
# SPDX-License-Identifier: Apache-2.0

if BOARD_VCU_STM32

config BOARD
	default "vcu_stm32"

endif # BOARD_VCU_STM32
```

## boards/st/vcu_stm32/Kconfig.vcu_stm32
```kconfig
# Copyright (c) 2025 VCU Team
# SPDX-License-Identifier: Apache-2.0

config BOARD_VCU_STM32
	select SOC_STM32H753XX
```
